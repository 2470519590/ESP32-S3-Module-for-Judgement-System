## main/Kconfig.projbuild
```kconfig
menu "Robot Wi-Fi"

config ROBOT_WIFI_SSID
    string "Wi-Fi profile 1 SSID"
    default "GAME_1"

config ROBOT_WIFI_PASSWORD
    string "Wi-Fi password"
    default "12345678"

config ROBOT_SERVER_IP
    string "Server IPv4"
    default "192.168.1.3"

config ROBOT_SERVER_PORT
    int "Server UDP port"
    range 1 65535
    default 5005

config ROBOT_LISTEN_PORT
    int "Robot UDP downlink listen port"
    range 1 65535
    default 5006

config ROBOT_REFEREE_UART_BAUD
    int "UART0 referee-system baud rate"
    range 1200 5000000
    default 115200

config ROBOT_RESERVED_UART_BAUD
    int "UART1 reserved baud rate"
    range 1200 5000000
    default 115200

config ROBOT_TEST_MODE
    bool "Generate simulated match data"
    default n
    help
        Send the normal 10 Hz status frames and generate one simulated
        asynchronous match event every 3 to 6 seconds. Disable before
        connecting the real referee system.

config ROBOT_GAME2_WIFI_SSID
    string "Wi-Fi profile 2 SSID"
    default "GAME_2"
    help
        Runtime profile 2, selected by the controller gesture.

config ROBOT_CHECKIN_WIFI_SSID
    string "Wi-Fi profile 3 SSID"
    default "CHECKIN"

endmenu
```
